## build/mcuboot/Kconfig/boards/Kconfig.defconfig
```kconfig
# Load Zephyr board defconfig descriptions.
osource "/home/olofjohnsson/ncs/v3.1.1/nrf/boards/nordic/thingy91x/Kconfig.defconfig"
```

## build/s1_image/Kconfig/boards/Kconfig.thingy91x
```kconfig
# Load board Kconfig descriptions.
osource "/home/olofjohnsson/ncs/v3.1.1/nrf/boards/nordic/thingy91x/Kconfig.thingy91x"
```
